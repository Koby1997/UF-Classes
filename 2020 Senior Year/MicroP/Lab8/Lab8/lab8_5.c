/*
 * Lab8.c
 *
 * Author : Koby
 */ 

#include <avr/io.h>
#include <avr/interrupt.h>

extern void clock_init(void);

int16_t frequency;
int16_t array_position;

uint16_t sine[256] =
{
	0x800,0x832,0x864,0x896,0x8c8,0x8fa,0x92c,0x95e,0x98f,0x9c0,
	0x9f1,0xa22,0xa52,0xa82,0xab1,0xae0,0xb0f,0xb3d,0xb6b,0xb98,
	0xbc5,0xbf1,0xc1c,0xc47,0xc71,0xc9a,0xcc3,0xceb,0xd12,0xd39,
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	0x6d3,0x705,0x737,0x769,0x79b,0x7cd,0x800
};

uint16_t triangle[256] =
{
	0x20,0x40,0x60,0x80,0xa0,0xc0,0xe0,0x100,0x120,0x140,
	0x160,0x180,0x1a0,0x1c0,0x1e0,0x200,0x220,0x240,0x260,0x280,
	0x2a0,0x2c0,0x2e0,0x300,0x320,0x340,0x360,0x380,0x3a0,0x3c0,
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	0xa0,0x80,0x60,0x40,0x20,0x0
};


int main(void)
{
	clock_init();
	tcc0_init();
	dma_init();
	dac_init();
	intr_init();
	usartd0_init();
		
    while (1) 
    {	
    }
}



void dac_init(void)
{
	/* Use only channel 1 */
	DACA.CTRLB = DAC_CHSEL_SINGLE1_gc | DAC_CH1TRIG_bm;
	
	/* Use AREFB (2.5V). Data is right-adjusted. */
	DACA.CTRLC = DAC_REFSEL_AREFB_gc;
	
	/* Enable channel 0, as well as the overall DAC module. */
	DACA.CTRLA = DAC_CH1EN_bm | DAC_ENABLE_bm;
	
	/* make a DAC conversion start when Event Channel 0 is triggered */
	DACA.EVCTRL = DAC_EVSEL_1_gc;
}

void intr_init(void)
{
	/* Enable low level interrupts in the PMIC. */
	PMIC.CTRL = PMIC_LOLVLEN_bm;
	
	/* Enable interrupts globally. */
	sei();
}


void tcc0_init(void)
{
	//;set TCC0 period register
	// we want sine wave with a 1000Hz frequency
	// but we have 256 values for each frequency
	// so our PER = (1/1760Hz) /256 = 1/256000
	//;TCC0_PER = (fclk/prescalar) * (duration in seconds)
	//;				32MH/1					1/459560
	//this didn't give a value withing 2% so I manually changed the PER
	
	TCC0.CNT = 0;
	TCC0.PER = 32000000/(frequency * 256); //(32000000/1) / 459560; // = 69 but didn't work
	TCC0.CTRLA = TC_CLKSEL_DIV1_gc;
	
	/* Clear OVFIF to be safe */
	TCC0.INTCTRLA = TC_OVFINTLVL_LO_gc;	
	
	/* Set as low level interrupt */
	TCC0.INTCTRLA = TC_OVFINTLVL_LO_gc;
	
	EVSYS.CH1MUX = EVSYS_CHMUX_TCC0_OVF_gc;
}


void dma_init(void)
{
	/* reset entire DMA periph */
	DMA.CTRL |= DMA_RESET_bm;
	
	DMA.CH0.CTRLA = DMA_CH_SINGLE_bm | DMA_CH_BURSTLEN_2BYTE_gc; // I think I need to change this to 2byte
	
	DMA.CH0.ADDRCTRL = DMA_CH_SRCRELOAD_BLOCK_gc | DMA_CH_SRCDIR_INC_gc | DMA_CH_DESTRELOAD_NONE_gc | DMA_CH_DESTDIR_FIXED_gc;
	
	DMA.CH0.TRIGSRC = DMA_CH_TRIGSRC_DACA_CH0_gc;//DMA_CH_TRIGSRC_DACA_CH0_gc  or DMA_CH_TRIGSRC_TCC0_OVF_gc change to TC interrupt
	
	DMA.CH0.TRFCNT = (uint16_t)(sizeof(sine));
	
	DMA.CH0.SRCADDR0 = (uint8_t)((uintptr_t)sine);
	DMA.CH0.SRCADDR1 = (uint8_t)(((uintptr_t)sine) >> 8);
	DMA.CH0.SRCADDR2 = (uint8_t)(((uint32_t)((uintptr_t)sine)) >> 16);
	
	DMA.CH0.DESTADDR0 = (uint8_t)((uintptr_t)&DACA.CH0DATA);
	DMA.CH0.DESTADDR1 = (uint8_t)(((uintptr_t)&DACA.CH0DATA) >> 8);
	DMA.CH0.DESTADDR2 = (uint8_t)(((uint32_t)((uintptr_t)&DACA.CH0DATA)) >> 16);
	
	
	
	/* enable CH0 */
	DMA.CH0.CTRLA |= DMA_CH_ENABLE_bm;
	
	/* enable entire DMA periph */
	DMA.CTRL = DMA_ENABLE_bm;
	
}


void usartd0_init()
{
	//BSEL = 1
	//BSCALE = -4
	
	/* Configure the UART frame. */
	USARTD0.CTRLC = ( USART_CMODE_ASYNCHRONOUS_gc | USART_PMODE_DISABLED_gc | USART_CHSIZE_8BIT_gc ); //need to use 8 bit
	
	/* Initialize the baud rate */
	USARTD0.BAUDCTRLA = 1;
	USARTD0.BAUDCTRLB = (-4<<4); //Should really or the high part of 1, but that is 0
	
	/* Enable the transmitter and receiver */
	USARTD0.CTRLB = ( USART_TXEN_bm | USART_RXEN_bm );
	
	USARTD0.CTRLA = 0b010000; //make low level. couldn't find the bm
	
}



ISR(TCC0_OVF_vect)
{
	DMA.CH0.CTRLA |= DMA_CH_ENABLE_bm;
	
	DMA.CH0.CTRLA |= DMA_CH_TRFREQ_bm;
}


ISR(USARTD0_RXC_vect)
{
	while(!(USARTD0.STATUS & USART_DREIF_bm)); //wait
	
	if(USARTD0.DATA == 's')
	{
		//change to triangle wave and sine wave
		//I would make this a boolean
				
	}
	else if(USARTD0.DATA == 'W')
	{
		frequency = 1046.5;
				
	}
	else if(USARTD0.DATA == '3')
	{
		frequency = 1108.73;
	}
	else if(USARTD0.DATA == 'E')
	{
		frequency = 1174.66;
	}
	else if(USARTD0.DATA == '4')
	{
		frequency = 1244.51;
	}	
	//Keep going. I would probably change to a case statement to make it shorter
}