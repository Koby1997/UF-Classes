/*
 * Lab8.c
 *
 * Author : Koby
 */ 

#include <avr/io.h>
#include <avr/interrupt.h>
#include <stdbool.h>

extern void clock_init(void);


int16_t array_position;
bool use_sine;
uint8_t data;

uint16_t sine[256] =
{
	0x800,0x832,0x864,0x896,0x8c8,0x8fa,0x92c,0x95e,0x98f,0x9c0,
	0x9f1,0xa22,0xa52,0xa82,0xab1,0xae0,0xb0f,0xb3d,0xb6b,0xb98,
	0xbc5,0xbf1,0xc1c,0xc47,0xc71,0xc9a,0xcc3,0xceb,0xd12,0xd39,
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	0x6d3,0x705,0x737,0x769,0x79b,0x7cd,0x800
};

uint16_t half[256] =
{
	0x405,0x41e,0x437,0x450,0x469,0x482,0x49b,0x4b4,0x4cd,0x4e6,
	0x4fe,0x517,0x52f,0x547,0x55f,0x577,0x58e,0x5a5,0x5bc,0x5d3,
	0x5e9,0x5ff,0x615,0x62b,0x640,0x655,0x669,0x67d,0x691,0x6a4,
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	0x36e,0x387,0x3a0,0x3b9,0x3d2,0x3eb,0x405
};

int main(void)
{
	clock_init();
	usartd0_init();
	dac_init();
	tcc0_init();
	intr_init();
	
	use_sine = true;
	array_position = 0;
	
	
    while (1) 
    {	
		while(!(DACA.STATUS & DAC_CH0DRE_bm));

		/* Write digital data to the CH0DATA register. 0 = 0V, 0xFFF = VREF. */
		
		if(use_sine == true)
		{
			DACA.CH0DATA = sine[array_position];
		}
		else
		{
			DACA.CH0DATA = half[array_position];
		}
		
		array_position++;
			
		if(array_position == 256)
		{
		array_position = 0;
		}	
    }
}



void dac_init(void)
{
	/* Use only channel 0 */
	DACA.CTRLB = DAC_CHSEL_SINGLE_gc | DAC_CH0TRIG_bm;
	
	/* Use AREFB (2.5V). Data is right-adjusted. */
	DACA.CTRLC = DAC_REFSEL_AREFB_gc;
	
	/* Enable channel 0, as well as the overall DAC module. */
	DACA.CTRLA = DAC_CH0EN_bm | DAC_ENABLE_bm;	
	
	/* make a DAC conversion start when Event Channel 0 is triggered */
	DACA.EVCTRL = DAC_EVSEL_0_gc;
}

void intr_init(void)
{
	/* Enable low level interrupts in the PMIC. */
	PMIC.CTRL = PMIC_LOLVLEN_bm;
	
	/* Enable interrupts globally. */
	sei();
}


void tcc0_init(void)
{
	//;set TCC0 period register
	// we want sine wave with a 1000Hz frequency
	// but we have 256 values for each frequency
	// so our PER = (1/1000Hz) /256 = 1/256000
	//;TCC0_PER = (fclk/prescalar) * (duration in seconds)
	//;				32MH/1					1/256000
	//this didn't give a value withing 2% so I manually changed the PER
	
	TCC0.CNT = 0;
	TCC0.PER = (32000000/1) / 256000; // = 125
	TCC0.CTRLA = TC_CLKSEL_DIV1_gc;
	
	/* Clear OVFIF to be safe */
	TCC0.INTCTRLA = TC_OVFINTLVL_LO_gc;	
	
	/* Set as low level interrupt */
	TCC0.INTCTRLA = TC_OVFINTLVL_LO_gc;
	
	EVSYS.CH0MUX = EVSYS_CHMUX_TCC0_OVF_gc;
}

void usartd0_init()
{
	//BSEL = 33
	//BSCALE = -1
	
	/* Configure the UART frame. */
	USARTD0.CTRLC = ( USART_CMODE_ASYNCHRONOUS_gc | USART_PMODE_DISABLED_gc | USART_CHSIZE_8BIT_gc ); //need to use 8 bit
	
	/* Initialize the baud rate */
	USARTD0.BAUDCTRLA = 33;
	USARTD0.BAUDCTRLB = (-1<<4); //Should really or the high part of 1, but that is 0
	
	/* Enable the transmitter and receiver */
	USARTD0.CTRLB = ( USART_TXEN_bm | USART_RXEN_bm );
	
	USARTD0.CTRLA = 0b00010000; //make low level. couldn't find the bm
	
}

ISR(USARTD0_RXC_vect)
{
	data = USARTD0.DATA;
	
	if(data == 'h')
	{
		use_sine = false;
	}
	else if(data == 'o')
	{
		use_sine = true;	
	}
}